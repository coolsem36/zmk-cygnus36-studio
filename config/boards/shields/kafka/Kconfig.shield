## config/boards/shields/kafka/Kconfig.shield
```kconfig
# Copyright (c) 2022 Duccio Breschi
# SPDX-License-Identifier: MIT

config SHIELD_CYGNUS_DONGLE
    def_bool $(shields_list_contains,cygnus_dongle)

config SHIELD_CYGNUS_PH_LEFT
    def_bool $(shields_list_contains,cygnus_ph_left)

config SHIELD_CYGNUS_RIGHT
    def_bool $(shields_list_contains,cygnus_right)
```
